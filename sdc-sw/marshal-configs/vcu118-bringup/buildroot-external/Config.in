## sdc-sw/marshal-configs/vcu118-bringup/buildroot-external/package/riscv-openocd/Config.in
```kconfig
config BR2_PACKAGE_RISCV_OPENOCD
	bool "riscv-openocd"
	help
	  OpenOCD - Open On-Chip Debugger (RISC-V)

	  http://openocd.sourceforge.net/
```
